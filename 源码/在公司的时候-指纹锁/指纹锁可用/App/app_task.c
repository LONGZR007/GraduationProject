/****************************************************************************************************
 * 描述：任务应用程序实现
 *
 * 作者：Gavin
 *
 * 版本：v1.0.0    日期：2018-04-12
 *                                                                              大连智海科技有限公司
****************************************************************************************************/

#include "stm32f10x_rtc.h"
#include "stm32f10x_nvic.h"
#include "stm32f10x_systick.h"
#include "app_task.h"
#include "drv_io.h"
#include "drv_oled.h"
#include "drv_si2c.h"
#include "drv_bmp.h"
#include "drv_remote.h"
#include "stm32f10x_tim.h"
#include "usart2.h"
#include "drv_as608.h"
#include "app_as608.h"

/****************************************************************************************************
 * 描述：初始化任务, 只在设备上电或复位后执行 1 次
 *
 * 参数：无
 *
 * 返回：无
****************************************************************************************************/

void Init_Task(void)
{
	NVIC_Init();                    // 中断初始化
	SysTick_Init(TICKS_PER_SEC);    // 滴答定时器初始化
	RTC_Init(RTC_SRC_HSE);          // 实时时钟初始化
	OLED_Init();		            // 初始化 OLED 
	OLED_Clear();                   // 清屏 OLED
	Remote_Init();                  // 红外遥控器初始化
	TIM2_PWM_Init(9999,7200-1);       // 舵机控制初始化14399, 99
	usart2_init(36,usart2_baund);	// 初始化串口2,用于与指纹模块通讯
	PS_StaGPIO_Init();              // 初始化
	while(PS_HandShake(&AS608Addr))//与AS608模块握手
	{
		OLED_ShowString(0,2,"Try to connect again....",16,1);
	}
	OLED_Clear();                   // 清屏 OLED  通讯成功
}

/****************************************************************************************************
 * 描述：实时任务, 每周期都执行
 *
 * 参数：*arg = 任务参数
 *
 * 返回：无
****************************************************************************************************/
u32 i;
void RT_Task(void *arg)
{
	do {
		
//		OLED_Clear();                   // 清屏 OLED
//		OLED_ShowString(0,2,"FANG SHOU ZHI",12,1);
//		AS608_Task();
//		Remote_Discern();

		
	} while (RTOS);
}

/****************************************************************************************************
 * 描述：1 秒周期任务, 1 秒执行一次
 *
 * 参数：*arg = 任务参数
 *
 * 返回：无
****************************************************************************************************/

void SEC_Task(void *arg)
{
	do {
          
		
		
		
#if RTOS
		Delay_sec(1);    // 休眠 1 Sec
#endif
	} while (RTOS);
}



/* End Of File */
